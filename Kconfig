## Kconfig
```kconfig
menu "ESP8266-general-component configuration"

  menu "Control configuration"

    choice ESP_BOARD_TYPE
      prompt "ESP board type"
      default ESP_BOARD_NODEMCU

      config ESP_BOARD_NODEMCU
        bool "NodeMCU"
      config ESP_BOARD_WEMOS_D1_MINI
        bool "Wemos D1 Mini"
      config ESP_BOARD_ESP_01S
        bool "ESP-01S"
      config ESP_BOARD_OTHER
        bool "OTHER"

    endchoice

  endmenu

  menu "Network configuration"

    config WIFI_SSID
      string "WiFi SSID"
      default "myssid"

    config WIFI_PASSWORD
      string "WiFi Password"
      default "mypassword"

    config NETWORK_TIMEOUT
      int "Network timeout"
      range 1 600
      default 30

    menuconfig IP4_ADDRESS
      bool "IP4 address"
      default n
    
    config IP4_ADDRESS_1
    depends on IP4_ADDRESS
    int  "IP4 address part 1"
    range 0 255
    default 192

    config IP4_ADDRESS_2
    depends on IP4_ADDRESS
    int  "IP4 address part 2"
    range 0 255
    default 168

    config IP4_ADDRESS_3
    depends on IP4_ADDRESS
    int  "IP4 address part 3"
    range 0 255
    default 1

    config IP4_ADDRESS_4
    depends on IP4_ADDRESS
    int  "IP4 address part 4"
    range 0 255
    default 2

  endmenu

  menu "Server configuration"

    config HTTPD_RESP_BUF_SIZE
      int "HTTPD response buffer size"
      range 128 2048
      default 512

  endmenu

  menu "Storage configuration"

    config SPIFFS_MAX_FILES
      int "SPIFFS max files"
      range 2 16
      default 8

  endmenu

endmenu
```

## sdkconfig.defaults
```kconfig
CONFIG_PARTITION_TABLE_CUSTOM=y
CONFIG_PARTITION_TABLE_CUSTOM_FILENAME="partitions_4M.csv"
CONFIG_PARTITION_TABLE_FILENAME="partitions_4M.csv"
CONFIG_HTTPD_MAX_REQ_HDR_LEN=1024
CONFIG_USING_SPIFFS=y
```
